## Documentation/devicetree/bindings/display/bridge/synopsys,dw-hdmi-qp.yaml
```yaml
# SPDX-License-Identifier: (GPL-2.0-only OR BSD-2-Clause)
%YAML 1.2
---
$id: http://devicetree.org/schemas/display/bridge/synopsys,dw-hdmi-qp.yaml#
$schema: http://devicetree.org/meta-schemas/core.yaml#

title: Common Properties for Synopsys DesignWare HDMI QP TX Controller IP

maintainers:
  - Cristian Ciocaltea <cristian.ciocaltea@collabora.com>

description: |
  This document defines device tree properties for the Synopsys DesignWare
  HDMI 2.1 Quad-Pixel (QP) TX controller IP core.
  It doesn't constitute a device tree binding specification by itself, but
  is meant to be referenced by platform-specific device tree bindings.

  When referenced from platform device tree bindings, the properties defined
  in this document are defined as follows. The platform device tree bindings
  are responsible for defining whether each property is required or optional.

properties:
  reg:
    maxItems: 1

  clocks:
    maxItems: 6
    items:
      - description: Peripheral/APB bus clock
    additionalItems: true

  clock-names:
    maxItems: 6
    items:
      - const: pclk
    additionalItems: true

  interrupts:
    minItems: 1
    maxItems: 5

additionalProperties: true
```

## Documentation/devicetree/bindings/display/panel/raspberrypi,touchscreen.txt
```
This binding covers the official 7" (800x480) Raspberry Pi touchscreen
panel.

This DSI panel contains:

- TC358762 DSI->DPI bridge
- Atmel microcontroller on I2C for power sequencing the DSI bridge and
  controlling backlight
- Touchscreen controller on I2C for touch input

and the binding currently covers the DSI display parts but not its
touch input.

Required properties:
- compatible:	Must be "raspberrypi,touchscreen"
- raspberrypi,touchscreen-bridge:
		Handle to the I2C device for Atmel microcontroller

Example:

dsi1: dsi@7e700000 {
	#address-cells = <1>;
	#size-cells = <0>;
	<...>

	pitouchscreen: panel@0 {
		compatible = "raspberrypi,touchscreen";
		reg = <0>;

		raspberrypi,touchscreen-bridge = <&pitouchscreen_bridge>;
	};
};

i2c_dsi: i2c {
	compatible = "i2c-gpio";
	#address-cells = <1>;
	#size-cells = <0>;
	gpios = <&gpio 28 0
		 &gpio 29 0>;

	pitouchscreen_bridge: bridge@45 {
		compatible = "raspberrypi,touchscreen-bridge-i2c";
		reg = <0x45>;
	};
};
```
